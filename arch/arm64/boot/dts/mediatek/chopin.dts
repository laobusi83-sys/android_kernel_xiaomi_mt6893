/*
 * Copyright (C) 2015 MediaTek Inc.
 *
 * This program is free software: you can redistribute it and/or modify
 * it under the terms of the GNU General Public License version 2 as
 * published by the Free Software Foundation.
 *
 * This program is distributed in the hope that it will be useful,
 * but WITHOUT ANY WARRANTY; without even the implied warranty of
 * MERCHANTABILITY or FITNESS FOR A PARTICULAR PURPOSE. See the
 GNU General Public License for more details.
 */

#include "mediatek/chopin-mt6891.dtsi"

/ {
        model = "CHOPIN";
        compatible = "mediatek,MT6891";

	bootargs = "console=tty0 console=ttyS0,921600n1 root=/dev/ram \
	vmalloc=400M slub_debug=OFZPU swiotlb=noforce \ 
	cgroup.memory=nosocket,nokmem \
	androidboot.selinux=permissive \
	page_owner=on nodebugmon loop.max_part=7";
	kaslr-seed = <0 0>;
};

